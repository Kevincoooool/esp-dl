## examples/8.lcd_camera_lvgl_v8/sdkconfig.defaults
```kconfig
# ESP32-S3 Posture Detection Camera Configuration

# Basic configuration
CONFIG_IDF_TARGET="esp32s3"
CONFIG_ESPTOOLPY_FLASHMODE_QIO=y
CONFIG_ESPTOOLPY_FLASHSIZE_16MB=y
CONFIG_PARTITION_TABLE_CUSTOM=y
CONFIG_PARTITION_TABLE_CUSTOM_FILENAME="partitions.csv"

# PSRAM configuration for AI inference
CONFIG_SPIRAM=y
CONFIG_SPIRAM_MODE_OCT=y
CONFIG_SPIRAM_SPEED_80M=y
CONFIG_SPIRAM_MALLOC_ALWAYSINTERNAL=16384
CONFIG_SPIRAM_MALLOC_RESERVE_INTERNAL=32768
CONFIG_SPIRAM_ALLOW_BSS_SEG_EXTERNAL_MEMORY=y

# CPU and performance optimization
CONFIG_ESP_DEFAULT_CPU_FREQ_MHZ_240=y
CONFIG_ESP32S3_DATA_CACHE_64KB=y
CONFIG_ESP32S3_DATA_CACHE_LINE_64B=y
CONFIG_ESP32S3_INSTRUCTION_CACHE_32KB=y

# FreeRTOS configuration
CONFIG_FREERTOS_UNICORE=n
CONFIG_FREERTOS_HZ=1000
CONFIG_FREERTOS_TIMER_TASK_STACK_DEPTH=4096

# Task watchdog configuration
CONFIG_ESP_TASK_WDT_TIMEOUT_S=40
CONFIG_ESP_TASK_WDT_CHECK_IDLE_TASK_CPU0=n
CONFIG_ESP_TASK_WDT_CHECK_IDLE_TASK_CPU1=n

# ESP-DL configuration (disabled for demo version)
# CONFIG_ESPDL_NETWORK_ON=y

# COCO Pose model configuration (disabled for demo version)
CONFIG_DEFAULT_COCO_POSE_MODEL=0
CONFIG_COCO_POSE_YOLO11N_POSE_S8_V2=y
CONFIG_COCO_POSE_MODEL_IN_FLASH_RODATA=y
CONFIG_COCO_POSE_MODEL_LOCATION=0

# Camera configuration
CONFIG_OV2640_SUPPORT=y
CONFIG_CAMERA_CORE0=n
CONFIG_CAMERA_CORE1=y
CONFIG_CAMERA_DMA_BUFFER_SIZE_MAX=32768

# WiFi and Bluetooth disabled to save memory
CONFIG_ESP32_WIFI_ENABLED=n
CONFIG_BT_ENABLED=n

# Log configuration
CONFIG_LOG_DEFAULT_LEVEL_INFO=y
CONFIG_LOG_MAXIMUM_LEVEL_DEBUG=y

# Compiler optimization
CONFIG_COMPILER_OPTIMIZATION_PERF=y
CONFIG_COMPILER_OPTIMIZATION_ASSERTIONS_SILENT=y

# lwIP optimization
CONFIG_LWIP_TCPIP_RECVMBOX_SIZE=64
CONFIG_LWIP_UDP_RECVMBOX_SIZE=16
CONFIG_LWIP_TCPIP_TASK_STACK_SIZE=4096

# LVGL configuration optimization
CONFIG_LV_MEM_SIZE=65536
CONFIG_LV_DISP_DEF_REFR_PERIOD=16
CONFIG_LV_INDEV_DEF_READ_PERIOD=16
CONFIG_LV_USE_DRAW_SW=y
CONFIG_LV_USE_DRAW_MASKS=y
CONFIG_LV_DRAW_COMPLEX=y

# Memory
CONFIG_ESP_SYSTEM_ALLOW_RTC_FAST_MEM_AS_HEAP=n

# FAT FS
CONFIG_FATFS_LFN_HEAP=y

# BSP
CONFIG_BSP_SD_FORMAT_ON_MOUNT_FAIL=y
```

## examples/posture_detection/sdkconfig.defaults
```kconfig
# Camera configuration
CONFIG_ESP32_CAMERA_TASK_PRIORITY=5
CONFIG_ESP32_CAMERA_TASK_STACK_SIZE=4096

# Wi-Fi (optional, for future extensions)
CONFIG_ESP32_WIFI_SW_COEXIST_ENABLE=y

# Memory optimization
CONFIG_ESP32_SPIRAM_SUPPORT=y
CONFIG_SPIRAM_USE_MALLOC=y
CONFIG_SPIRAM_MALLOC_ALWAYSINTERNAL=16384

# Logging
CONFIG_LOG_DEFAULT_LEVEL_INFO=y
CONFIG_LOG_DEFAULT_LEVEL=3

# FreeRTOS
CONFIG_FREERTOS_HZ=1000

# ESP32-S3 specific
CONFIG_ESP32S3_SPIRAM_SUPPORT=y
CONFIG_SPIRAM_MODE_OCT=y
CONFIG_SPIRAM_SPEED_80M=y

# Compiler optimization
CONFIG_COMPILER_OPTIMIZATION_SIZE=y 
```
